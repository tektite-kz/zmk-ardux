## config/west.yml
```yaml
manifest:
  remotes:
    - name: zmkfirmware
      url-base: https://github.com/zmkfirmware
    - name: zmk-ardux
      url-base: https://github.com/arduxio
  projects:
    - name: zmk
      remote: zmkfirmware
      revision: 8c6bda260ace119b3c22a21bdcdd6d17a83fc5eb
      import: app/west.yml
  self:
    path: config
```
